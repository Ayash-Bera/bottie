## firmware/network/Kconfig
```kconfig
menu "Bottie companion transport"
    config BOTTIE_NETWORK_ENABLED
        bool "Compile opt-in companion connection support"
        default n
        help
            Does not start a connection by itself. The application must explicitly
            call Client::start() from its live-mode background task. Credentials
            belong in the ignored network.local.hpp, never in sdkconfig.
endmenu
```

## firmware/sdkconfig.defaults
```kconfig
CONFIG_ESP_CONSOLE_USB_SERIAL_JTAG=y
CONFIG_ESP_CONSOLE_SECONDARY_NONE=y
CONFIG_ESPTOOLPY_FLASHMODE_DIO=y
CONFIG_ESPTOOLPY_FLASHFREQ_40M=y
```
